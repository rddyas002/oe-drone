## build/conf/bblayers.conf
```bitbake
# POKY_BBLAYERS_CONF_VERSION is increased each time build/conf/bblayers.conf
# changes incompatibly
POKY_BBLAYERS_CONF_VERSION = "2"

BBPATH = "${TOPDIR}"
BBFILES ?= ""

BBLAYERS ?= " \
  /home/reddi/work/bbb_rt/poky-morty/meta \
  /home/reddi/work/bbb_rt/poky-morty/meta-openembedded/meta-oe \
  /home/reddi/work/bbb_rt/poky-morty/meta-poky \
  /home/reddi/work/bbb_rt/poky-morty/meta-yocto-bsp \
  /home/reddi/work/bbb_rt/drone/meta-drone \
  "
```

## oe-drone/build/conf/bblayers.conf
```bitbake
# POKY_BBLAYERS_CONF_VERSION is increased each time build/conf/bblayers.conf
# changes incompatibly
POKY_BBLAYERS_CONF_VERSION = "2"

BBPATH = "${TOPDIR}"
BBFILES ?= ""

BBLAYERS ?= " \
  ${TOPDIR}/../../poky-morty/meta \
  ${TOPDIR}/../../poky-morty/meta-poky \
  ${TOPDIR}/../../poky-morty/meta-ti \
  ${TOPDIR}/../../poky-morty/meta-openembedded/meta-oe \
  ${TOPDIR}/../../poky-morty/meta-beagleboard/meta-beagleboard-extras \
  ${TOPDIR}/../meta-drone \
  "
```

## oe-drone/meta-drone/conf/layer.conf
```bitbake
# We have a conf and classes directory, add to BBPATH
BBPATH .= ":${LAYERDIR}"

# We have recipes-* directories, add to BBFILES
BBFILES += "${LAYERDIR}/recipes-*/*/*.bb \
	${LAYERDIR}/recipes-*/*/*.bbappend"

BBFILE_COLLECTIONS += "drone"
BBFILE_PATTERN_drone = "^${LAYERDIR}/"
BBFILE_PRIORITY_drone = "10"
```
